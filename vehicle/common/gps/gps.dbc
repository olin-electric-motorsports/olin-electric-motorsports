VERSION ""

NS_ :

BS_:

BO_ 1186 gps_coords: 8 canGPS_V2
 SG_ latitude  :  0|32@1- (0.0000001,0) 	[-90|90] "deg"  Vector__XXX
 SG_ longitude : 32|32@1- (0.0000001,0) 	[-180|180] "deg"  Vector__XXX
